/dts-v1/;
#include "a10ad9371_foxconn_base.dtsi"
#include "a10ad9371_foxconn_mgp_clk.dtsi"
#include "a10ad9371_foxconn_mgp_n1.dtsi"
#include "a10ad9371_foxconn_mgp_n2.dtsi"
//#include "a10ad9371_foxconn_mgp_n3.dtsi"
//#include "a10ad9371_foxconn_mgp_n4.dtsi"
