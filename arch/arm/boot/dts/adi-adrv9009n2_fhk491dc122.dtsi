/* Tx_BW450_IR491p52_Rx_BW200_OR245p76_ORx_BW450_OR491p52_DC122p88
History:
  base: "adi-adrv9009_fhk491dc245.dtsi"
*/

#include <dt-bindings/iio/frequency/ad9528.h>
#include <dt-bindings/gpio/gpio.h>
#include <dt-bindings/interrupt-controller/irq.h>

#include "adi-adrv9009n2_fhk491dc245.dtsi"


		/*&ad9528_0_c13 {
			adi,channel-divider = <10>;
		};*/



		/*&ad9528_0_c1 {
			adi,channel-divider = <10>;
		};*/
		/*&ad9528_0_c8 {
			adi,channel-divider = <10>;
		};
		&ad9528_0_c12 {
			adi,channel-divider = <10>;
		};*/
		&ad9528_0_c0 {
			adi,channel-divider = <10>;
		};
		/*&ad9528_0_c3 {
			adi,channel-divider = <10>;
		};
		&ad9528_0_c7 {
			adi,channel-divider = <10>;
		};*/

	&trx0_adrv9009n2 {
        // it means changes for AD9528-output-channel "DEV_CLK"
		adi,dig-clocks-device-clock_khz = <122880>;
	};


